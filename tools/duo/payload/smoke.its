## tools/duo/payload/smoke.its
```
/dts-v1/;

/*
 * FIT wrapper for the Milk-V Duo bring-up payload.
 *
 * `@LOAD@`, `@BINARY@` and `@DTB@` are substituted by
 * `scripts/build/build-duo-payload.py` so that `sel4/pins.toml [cv1800b_duo]`
 * stays the single source of truth for where the payload runs. Do not write a
 * literal address here.
 *
 * Two hard constraints, both read out of the vendor U-Boot 2021.10 source:
 *
 *  1. The kernel subimage must be `type = "kernel"`, never `kernel_noload`. In
 *     `common/bootm.c` this U-Boot rewrites a noload image's load to the FIT's
 *     in-memory address and does `images.ep += images.os.image_start`, i.e. it
 *     treats `entry` as an OFFSET INTO THE FIT DATA. With `kernel` the data is
 *     copied to `load` and control transfers to the absolute `entry` declared
 *     here.
 *
 *  2. A `flat_dt` node is REQUIRED. `arch/riscv/lib/bootm.c`'s
 *     `boot_prep_linux()` prints "Device tree not found or missing FDT support"
 *     and `hang()`s when the FIT carries none. It then calls
 *     `kernel(hart_id, fdt_addr)`, which is exactly the a0/a1 S-mode handoff an
 *     seL4 elfloader expects — so this path is the one a real port will use.
 *
 * `os = "linux"` selects that RISC-V boot method. The payload is not Linux; the
 * string names the handoff convention, not the payload's identity.
 */

/ {
    description = "Slime OS Milk-V Duo bring-up payload";
    #address-cells = <2>;

    images {
        kernel-1 {
            description = "S-mode bring-up payload";
            data = /incbin/("@BINARY@");
            type = "kernel";
            arch = "riscv";
            os = "linux";
            compression = "none";
            load = <0x0 @LOAD@>;
            entry = <0x0 @LOAD@>;
            hash-1 {
                algo = "crc32";
            };
        };

        fdt-duo {
            description = "Milk-V Duo device tree, captured from the board";
            data = /incbin/("@DTB@");
            type = "flat_dt";
            arch = "riscv";
            compression = "none";
            hash-1 {
                algo = "crc32";
            };
        };
    };

    configurations {
        default = "config-duo";

        config-duo {
            description = "bring-up payload with the board's own device tree";
            kernel = "kernel-1";
            fdt = "fdt-duo";
        };
    };
};
```
